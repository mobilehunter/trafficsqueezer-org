## linux-3.13.0-ubuntu/net/trafficsqueezer/Kconfig
```kconfig
#
# TrafficSqueezer   - configuration
#
config TRAFFICSQUEEZER
	bool "TrafficSqueezer [TS]"
	default y
	---help---

	  If unsure, say Y.

config TRAFFICSQUEEZER_DEBUG
	bool "TS - Debug Packets"
	default y
```
